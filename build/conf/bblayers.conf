## build/conf/bblayers.conf
```bitbake
# POKY_BBLAYERS_CONF_VERSION is increased each time build/conf/bblayers.conf
# changes incompatibly
POKY_BBLAYERS_CONF_VERSION = "2"

BBPATH = "${TOPDIR}"
BBFILES ?= ""

BBLAYERS ?= " \
  /home/ton/beaglebone_os/poky/meta \
  /home/ton/beaglebone_os/poky/meta-poky \
  /home/ton/beaglebone_os/poky/meta-yocto-bsp \
  /home/ton/beaglebone_os/poky/meta-openembedded/meta-oe \
  /home/ton/beaglebone_os/sources/meta-bbb \
  "
```
